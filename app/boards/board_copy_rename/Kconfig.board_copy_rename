## app/boards/board_copy_rename/Kconfig.board_copy_rename
```kconfig
# Copyright (c) 2017 Linaro Limited
# SPDX-License-Identifier: Apache-2.0

config BOARD_BOARD_COPY_RENAME
	select SOC_STM32F429XX
```

## app/boards/board_copy_rename/board.yml
```yaml
board:
  name: board_copy_rename
  full_name: Board Copy Rename
  vendor: st
  socs:
    - name: stm32f429xx
```

## app/boards/board_scratch/board.yml
```yaml
board:
  name: board_scratch
  full_name: Board Scratch
  vendor: st
  socs:
    - name: stm32f429xx
```

## app/modules/our_custom_drivers/dts/bindings/driver/our,driver.yaml
```yaml
description: Our custom sensor driver binding
compatible: "our,driver"
include: sensor-device.yaml
properties:
  led-gpios:
    type: phandle-array
    required: true
```

## twister-out/native_sim_native/host_gnu/zephyr-course/tests/ring_buf/homework.unit.ring_buf/Kconfig/arch/Kconfig
```kconfig
# Load Zephyr Arch Kconfig descriptions.
osource "/home/jojo/Projects/zephyr/zephyr/arch/rx/Kconfig"
osource "/home/jojo/Projects/zephyr/zephyr/arch/x86/Kconfig"
osource "/home/jojo/Projects/zephyr/zephyr/arch/xtensa/Kconfig"
osource "/home/jojo/Projects/zephyr/zephyr/arch/sparc/Kconfig"
osource "/home/jojo/Projects/zephyr/zephyr/arch/riscv/Kconfig"
osource "/home/jojo/Projects/zephyr/zephyr/arch/posix/Kconfig"
osource "/home/jojo/Projects/zephyr/zephyr/arch/openrisc/Kconfig"
osource "/home/jojo/Projects/zephyr/zephyr/arch/mips/Kconfig"
osource "/home/jojo/Projects/zephyr/zephyr/arch/arm64/Kconfig"
osource "/home/jojo/Projects/zephyr/zephyr/arch/arm/Kconfig"
osource "/home/jojo/Projects/zephyr/zephyr/arch/arc/Kconfig"
```

## twister-out/native_sim_native/host_gnu/zephyr-course/tests/ring_buf/homework.unit.ring_buf/Kconfig/boards/Kconfig.defconfig.tmp
```kconfig
# Load Zephyr board defconfig descriptions.
osource "/home/jojo/Projects/zephyr/zephyr/boards/native/native_sim/Kconfig.defconfig"
```

## twister-out/native_sim_native/host_gnu/zephyr-course/tests/ring_buf/homework.unit.ring_buf/Kconfig/boards/Kconfig.native_sim
```kconfig
# Load board Kconfig descriptions.
osource "/home/jojo/Projects/zephyr/zephyr/boards/native/native_sim/Kconfig.native_sim"
```

## twister-out/native_sim_native/host_gnu/zephyr-course/tests/ring_buf/homework.unit.ring_buf/Kconfig/boards/Kconfig.sysbuild.tmp
```kconfig
# Load Sysbuild board Kconfig descriptions.
osource "/home/jojo/Projects/zephyr/zephyr/boards/native/native_sim/Kconfig.sysbuild"
```
